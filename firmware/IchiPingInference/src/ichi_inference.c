#include "ichi_inference.h"

#include <stddef.h>

#define ODL_DISABLE_RAND_GENERATOR_ALPHA
#include "solistAi.h"
#include "mcu.h"
#include "smpl_common.h"
#include "wdt.h"
#include "Fram.h"
#include "SoftSpi.h"
#include "ichi_calib_prior.h"

extern int8_t ichi_shared_scratch[];                    /* ichi_feature.c (4 KB, aligned) */

#define AI_INSTANCE    (0U)
#define AI_BUSY_LIMIT  (65535UL)
#define SYSTICK_WRAP   (0x01000000UL)
#define CPU_MHZ        (48UL)

static uint32_t last_accelerator_ticks;
static bool model_loaded;

static float bfloat16_to_float(bfloat16 value)
{
    union { uint32_t bits; float value; } converted;
    converted.bits = ((uint32_t)(uint16_t)value) << 16;
    return converted.value;
}

/* Load the ELM into accelerator instance 0.  Alpha is regenerated by the
   accelerator from seed/scaleAlpha (ODL_SetWeightAlpha is a stub in the
   library), so only Beta is transferred.  The model is loaded once (first
   prediction or an explicit call) so an on-site calibrated beta is kept. */
static void load_model(void)
{
    ODL_Parameters parameters = {
        .inputSize = ICHI_MODEL_INPUT_SIZE,
        .hiddenSize = ICHI_MODEL_HIDDEN_SIZE,
        .outputSize = ICHI_MODEL_OUTPUT_SIZE,
        .forgettingFactor = (bfloat16)0x3F80,
        .activationFunction = ICHI_MODEL_ACTIVATION,
        .lossFunction = ICHI_MODEL_LOSS,
        .seed = ICHI_MODEL_SEED,
        .scaleAlpha = (bfloat16)ICHI_MODEL_SCALE_ALPHA_BF16,
        .scaleGamma = 0,
        .leakRate = 0
    };
    uint16_t row;

    smpl_enablePeripheral(AI_PERI);
    ODL_Initialize(AI_INSTANCE, &parameters);
    ODL_Reset(AI_INSTANCE);
    for (row = 0U; row < ICHI_MODEL_HIDDEN_SIZE; row++)
    {
        ODL_SetWeightBeta(&ichi_model_beta[row * ICHI_MODEL_OUTPUT_SIZE], AI_INSTANCE,
                          (uint32_t)row * ICHI_MODEL_OUTPUT_SIZE * 2U,
                          ICHI_MODEL_OUTPUT_SIZE * 2U);
    }
    model_loaded = true;
}

void IchiInferenceInitialize(void)
{
    load_model();
}

void IchiInferenceUseFactory(void)
{
    load_model();
}

/* On-site calibration: the OS-ELM update runs in float32 on the CPU.  The AxlCORE's own
   ODL (ODL_StartTrain) keeps beta and P in bf16; over 160 updates the rounding piles up and
   beta degrades or blows up (2026-09-26 board: every state predicted as the first calibrated
   one), while the same update in float32 stays exact (sim/eval_odl_calibration.py).
   P (32 x 32) and beta (32 x 32) in float32 are 8 KB, more than the free RAM, so they live in
   the on-board FRAM and are streamed row by row; the work vectors use ichi_shared_scratch,
   which is idle once the front-end has produced elm_input.  After every update the new beta
   is written to the AxlCORE in bf16, so inference stays on the accelerator. */
#define CAL_FRAM_P     (100000UL)                    /* unused by the vendor firmware */
#define CAL_FRAM_BETA  (CAL_FRAM_P + (uint32_t)ICHI_MODEL_HIDDEN_SIZE * ICHI_MODEL_HIDDEN_SIZE * 4UL)
#define CAL_ROW_BYTES_P    ((int)(ICHI_MODEL_HIDDEN_SIZE * 4U))
#define CAL_ROW_BYTES_BETA ((int)(ICHI_MODEL_OUTPUT_SIZE * 4U))

static bool fram_ready;

static bfloat16 float_to_bf16_bits(float value)
{
    union { uint32_t bits; float value; } c;
    c.value = value;
    c.bits += 0x7FFFUL + ((c.bits >> 16) & 1UL);
    return (bfloat16)(c.bits >> 16);
}

bool IchiInferenceCalibrationBegin(void)
{
    float *row = (float *)(void *)ichi_shared_scratch;
    uint16_t r, c;
    load_model();                                        /* pre-trained beta, fresh state */
    if (!fram_ready)
    {
        SoftSpiPeripheralInit();
        FramInit();
        fram_ready = true;
    }
    for (r = 0U; r < ICHI_MODEL_HIDDEN_SIZE; r++)
    {
        FramWriteBlock(CAL_FRAM_P + (uint32_t)r * CAL_ROW_BYTES_P, &ichi_calib_p0[r * ICHI_MODEL_HIDDEN_SIZE],
                       CAL_ROW_BYTES_P);
        for (c = 0U; c < ICHI_MODEL_OUTPUT_SIZE; c++)
        {
            row[c] = bfloat16_to_float(ichi_model_beta[r * ICHI_MODEL_OUTPUT_SIZE + c]);
        }
        FramWriteBlock(CAL_FRAM_BETA + (uint32_t)r * CAL_ROW_BYTES_BETA, row, CAL_ROW_BYTES_BETA);
        wdt_clear();
    }
    /* read one value back: a missing / write-protected FRAM would silently corrupt the update */
    FramReadBlock(CAL_FRAM_P, row, 4);
    return row[0] == ichi_calib_p0[0];
}

uint32_t IchiInferenceLastAcceleratorUs(void)
{
    return last_accelerator_ticks / CPU_MHZ;
}

static bool run_elm(const bfloat16 *input, float output[ICHI_INFERENCE_OUTPUT_COUNT],
                    uint8_t *class_id)
{
    bfloat16 raw_output[ICHI_MODEL_OUTPUT_SIZE];
    uint32_t busy_count = 0UL;
    uint32_t start;
    uint32_t end;
    uint8_t index;
    uint8_t best = 0U;

    if (!model_loaded) { load_model(); }
    start = SysTick->VAL;
    ODL_StartPredict(AI_INSTANCE, (bfloat16 *)input, NULL);
    while (ODL_IsBusy() != 0UL)
    {
        if (++busy_count >= AI_BUSY_LIMIT)
        {
            return false;
        }
        wdt_clear();
    }
    end = SysTick->VAL;
    last_accelerator_ticks = (start >= end) ? (start - end) : (start + SYSTICK_WRAP - end);
    ODL_GetResult(AI_INSTANCE, raw_output);
    for (index = 0U; index < ICHI_MODEL_OUTPUT_SIZE; index++)
    {
        output[index] = bfloat16_to_float(raw_output[index]);
        if (output[index] > output[best])
        {
            best = index;
        }
    }
    *class_id = best;
    return true;
}

#ifdef ICHI_FRONTEND_ENABLED
/* ---- int8 CNN front-end (Cortex-M0+) --------------------------------------
   Same arithmetic as sim/emit_frontend_model.py int_forward():
   int8 x int8 -> int32 accumulate, v = (float)acc * M[o] + B[o],
   v <= 0 -> 0 (ReLU), v >= 126.5 -> 127, otherwise floor(v + 0.5).
   Activations are stored channel-major ([channel][position]) in two
   ping-pong buffers.  The buffers live in ichi_shared_scratch; ichi_feature.c
   provides a larger strong definition that doubles as its FFT work area. */
__attribute__((weak, aligned(4))) int8_t ichi_shared_scratch[2U * ICHI_FRONT_MAX_ACT];
static bfloat16 elm_input[ICHI_MODEL_INPUT_SIZE];

static int8_t requantize(int32_t acc, float mult, float bias)
{
    float v = (float)acc * mult + bias;
    if (v <= 0.0f) { return 0; }
    if (v >= 126.5f) { return 127; }
    return (int8_t)(int32_t)(v + 0.5f);
}

static void conv1d(const IchiFrontLayer *layer, const int8_t *in, int8_t *out)
{
    uint16_t o, t, c, k;
    for (o = 0U; o < layer->out_ch; o++)
    {
        for (t = 0U; t < layer->out_len; t++)
        {
            int32_t acc = 0;
            for (c = 0U; c < layer->in_ch; c++)
            {
                const int8_t *x = &in[(uint32_t)c * layer->in_len + (uint32_t)t * layer->stride];
                const int8_t *w = &layer->w[((uint32_t)o * layer->in_ch + c) * layer->kernel];
                for (k = 0U; k < layer->kernel; k++)
                {
                    acc += (int32_t)x[k] * (int32_t)w[k];
                }
            }
            out[(uint32_t)o * layer->out_len + t] = requantize(acc, layer->m[o], layer->b[o]);
        }
        wdt_clear();
    }
}

static bfloat16 float_to_bfloat16(float value)
{
    union { uint32_t bits; float value; } converted;
    converted.value = value;
    converted.bits += 0x7FFFUL + ((converted.bits >> 16) & 1UL);   /* round to nearest even */
    return (bfloat16)(uint16_t)(converted.bits >> 16);
}

/* int8 features -> bfloat16 ELM input (embedding, zero padded to ICHI_MODEL_INPUT_SIZE). */
static void run_frontend(const int8_t *input)
{
    const int8_t *src = input;
    uint8_t layer;
    uint16_t o, i;

    for (layer = 0U; layer < ICHI_FRONT_LAYERS; layer++)
    {
        int8_t *dst = &ichi_shared_scratch[(uint32_t)(layer & 1U) * ICHI_FRONT_MAX_ACT];
        conv1d(&ichi_front_layers[layer], src, dst);
        src = dst;
    }
    for (i = 0U; i < ICHI_MODEL_INPUT_SIZE; i++)
    {
        elm_input[i] = 0;
    }
    for (o = 0U; o < ICHI_FRONT_EMB; o++)
    {
        const int8_t *w = &ichi_front_fc_w[(uint32_t)o * ICHI_FRONT_FLAT];
        int32_t acc = 0;
        float e;
        for (i = 0U; i < ICHI_FRONT_FLAT; i++)
        {
            acc += (int32_t)src[i] * (int32_t)w[i];
        }
        e = (float)acc * ichi_front_fc_m[o] + ichi_front_fc_b[o];
        if (e < 0.0f) { e = 0.0f; }
        elm_input[o] = float_to_bfloat16(e * ichi_front_emb_mul[o] + ichi_front_emb_add[o]);
    }
    wdt_clear();
}
#endif

bool IchiInferenceRun(const uint8_t *input, float output[ICHI_INFERENCE_OUTPUT_COUNT],
                      uint8_t *class_id)
{
    if ((input == NULL) || (output == NULL) || (class_id == NULL))
    {
        return false;
    }
#ifdef ICHI_FRONTEND_ENABLED
    run_frontend((const int8_t *)input);
    return run_elm(elm_input, output, class_id);
#else
    return run_elm((const bfloat16 *)input, output, class_id);
#endif
}

/* One OS-ELM (recursive least squares, forgetting factor 1) update in float32:
     h = hard_sigmoid(0.2 x.alpha + 0.5)      (the AxlCORE hidden layer, bf16 like the accelerator)
     Ph = P h,  k = Ph / (1 + h.Ph),  P -= k Ph^T,  e = t - h.beta,  beta += k e^T
   P and beta are streamed row by row from / to the FRAM (see IchiInferenceCalibrationBegin). */
bool IchiInferenceTrain(const uint8_t *input, uint8_t class_id)
{
#ifdef ICHI_FRONTEND_ENABLED
    float *h = (float *)(void *)ichi_shared_scratch;     /* work vectors, 4 x 32 floats + bf16 row */
    float *ph = &h[ICHI_MODEL_HIDDEN_SIZE];
    float *e = &ph[ICHI_MODEL_HIDDEN_SIZE];
    float *row = &e[ICHI_MODEL_OUTPUT_SIZE];
    bfloat16 *row_bf16 = (bfloat16 *)(void *)&row[ICHI_MODEL_HIDDEN_SIZE];
    float denom = 1.0f;
    uint16_t i, j;
    if ((input == NULL) || (class_id >= ICHI_MODEL_OUTPUT_SIZE) || !fram_ready) { return false; }
    if (!model_loaded) { load_model(); }
    run_frontend((const int8_t *)input);                 /* elm_input; the scratch is free after this */

    for (j = 0U; j < ICHI_MODEL_HIDDEN_SIZE; j++)
    {
        float z = 0.0f;
        for (i = 0U; i < ICHI_CAL_ALPHA_ROWS; i++)
        {
            z += bfloat16_to_float(elm_input[i]) *
                 bfloat16_to_float(ichi_calib_alpha[i * ICHI_MODEL_HIDDEN_SIZE + j]);
        }
        z = 0.2f * z + 0.5f;
        h[j] = bfloat16_to_float(float_to_bf16_bits((z < 0.0f) ? 0.0f : ((z > 1.0f) ? 1.0f : z)));
    }
    for (j = 0U; j < ICHI_MODEL_HIDDEN_SIZE; j++)       /* Ph = P h, denom = 1 + h.Ph */
    {
        float s = 0.0f;
        FramReadBlock(CAL_FRAM_P + (uint32_t)j * CAL_ROW_BYTES_P, row, CAL_ROW_BYTES_P);
        for (i = 0U; i < ICHI_MODEL_HIDDEN_SIZE; i++) { s += row[i] * h[i]; }
        ph[j] = s;
        denom += h[j] * s;
    }
    for (j = 0U; j < ICHI_MODEL_HIDDEN_SIZE; j++)       /* P -= Ph Ph^T / denom */
    {
        FramReadBlock(CAL_FRAM_P + (uint32_t)j * CAL_ROW_BYTES_P, row, CAL_ROW_BYTES_P);
        for (i = 0U; i < ICHI_MODEL_HIDDEN_SIZE; i++) { row[i] -= ph[j] * ph[i] / denom; }
        FramWriteBlock(CAL_FRAM_P + (uint32_t)j * CAL_ROW_BYTES_P, row, CAL_ROW_BYTES_P);
        wdt_clear();
    }
    for (i = 0U; i < ICHI_MODEL_OUTPUT_SIZE; i++) { e[i] = (i == class_id) ? 1.0f : 0.0f; }
    for (j = 0U; j < ICHI_MODEL_HIDDEN_SIZE; j++)       /* e = t - h.beta */
    {
        FramReadBlock(CAL_FRAM_BETA + (uint32_t)j * CAL_ROW_BYTES_BETA, row, CAL_ROW_BYTES_BETA);
        for (i = 0U; i < ICHI_MODEL_OUTPUT_SIZE; i++) { e[i] -= h[j] * row[i]; }
    }
    for (j = 0U; j < ICHI_MODEL_HIDDEN_SIZE; j++)       /* beta += k e^T, k = Ph / denom */
    {
        float k = ph[j] / denom;
        FramReadBlock(CAL_FRAM_BETA + (uint32_t)j * CAL_ROW_BYTES_BETA, row, CAL_ROW_BYTES_BETA);
        for (i = 0U; i < ICHI_MODEL_OUTPUT_SIZE; i++)
        {
            row[i] += k * e[i];
            row_bf16[i] = float_to_bf16_bits(row[i]);
        }
        FramWriteBlock(CAL_FRAM_BETA + (uint32_t)j * CAL_ROW_BYTES_BETA, row, CAL_ROW_BYTES_BETA);
        ODL_SetWeightBeta(row_bf16, AI_INSTANCE, (uint32_t)j * ICHI_MODEL_OUTPUT_SIZE * 2U,
                          ICHI_MODEL_OUTPUT_SIZE * 2U);
        wdt_clear();
    }
    return true;
#else
    (void)input;
    (void)class_id;
    return false;                                        /* calibration needs the front-end model */
#endif
}

const int16_t *IchiInferenceElmInput(void)
{
#ifdef ICHI_FRONTEND_ENABLED
    return (const int16_t *)elm_input;
#else
    return NULL;
#endif
}
